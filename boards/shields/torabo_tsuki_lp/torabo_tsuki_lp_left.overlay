#include "torabo_tsuki_lp.dtsi"
#include <input/processors.dtsi>
#include <dt-bindings/zmk/input_transform.h>

&pointing_listener {
    input-processors = <&zip_xy_transform (INPUT_TRANSFORM_X_INVERT | INPUT_TRANSFORM_Y_INVERT)>,
<&zip_temp_layer 8 10000>;
};

&zip_temp_layer {
    require-prior-idle-ms = <150>;
    excluded-positions = <33 34 35>; // J K L
};
